#define MAXSAMPLETEST 5

uint8_t f697[] = {0x8B, 0xB3, 0xDB, 0xE5, 0xD3, 0xA7, 0x71, 0x3E, 0x1F, 0x1B, 0x35, 0x65, 0x9C,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 0xE7, 0xD5};
uint8_t f770[] = {0x8C, 0xB8, 0xE0, 0xE2, 0xC4, 0x8B, 0x50, 0x24, 0x1A, 0x33, 0x68, 0xA4, 0xD4,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 0xA4, 0xD4};
uint8_t f852[] = {0x8E, 0xBD, 0xE4, 0xDC, 0xAE, 0x6A, 0x31, 0x19, 0x2E, 0x65, 0xA8, 0xDA, 0xE4,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 0xB5, 0xDF};
uint8_t f941[] = {0x8F, 0xC2, 0xE7, 0xD0, 0x93, 0x49, 0x1D, 0x24, 0x5B, 0xA4, 0xDB, 0xE2, 0xB6,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 0xE4, 0xB5};

uint8_t f1029[] = {0x94, 0xCF, 0xE2, 0x9C, 0x42, 0x19, 0x47, 0xA4, 0xE3, 0xCE, 0x78, 0x28, 0x21,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 0x4F, 0xAE};
uint8_t f1336[] = {0x96, 0xD5, 0xDA, 0x7E, 0x27, 0x27, 0x81, 0xD8, 0xD8, 0x7D, 0x26, 0x28, 0x82,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 0xAA, 0xE2};
uint8_t f1477[] = {0x99, 0xD9, 0xCD, 0x5C, 0x1A, 0x4F, 0xC0, 0xE2, 0x8F, 0x28, 0x2B, 0x93, 0xE4,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 0x5A, 0x1D};
uint8_t f1633[] = {0x9C, 0xDD, 0xBA, 0x3B, 0x23, 0x8C, 0xE5, 0xAB, 0x34, 0x28, 0x9A, 0xE6, 0xA0,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 0xB2, 0x3B};



uint8_t t_x[MAXSAMPLETEST + 1];
uint8_t t_y[MAXSAMPLETEST + 1];
int t_xcounter;
int t_ycounter;
uint8_t sample[200];
uint16_t result[8];
int dec_result[16];

unsigned long avg;


unsigned long newTime;
int maxresult;
int maxresult_f;
int secmaxresult;
int secmaxresult_f;
int maxdec_result;
int maxdec_result_f;


void setup() {
  Serial.begin(115200);
}

void loop() {

  for (int i = 0; i < 200; i++) {
    newTime = micros();
    sample[i] = analogRead(A0) ;
    sample[i] = map(sample[i], 90, 130, 0, 6);
    //Serial.println(sample[i]);
    while (micros() < (newTime + 125)) {
      /* do nothing to wait */
    }
  }

  for ( int i = 0; i < 200; i++) {
    result[0] += sample[i] * f697[i];
    result[1] += sample[i] * f770[i];
    result[2] += sample[i] * f852[i];
    result[3] += sample[i] * f941[i];
    result[4] += sample[i] * f1029[i];
    result[5] += sample[i] * f1336[i];
    result[6] += sample[i] * f1477[i];
    result[7] += sample[i] * f1633[i];
  }

  for (int i = 0 ; i < 8; i++) {
    //Serial.print(result[i]);
    //Serial.print(",");
    result[i] = 0;
  }
  //Serial.println();

  for (int i = 0; i < 8; i++) {
    avg += result[i];
    if (result[i] > maxresult) {
      maxresult = result[i];
      maxresult_f = i;
    }
  }
  result[maxresult_f] = 0;


  for (int i = 0; i < 8; i++) {
    if (result[i] > secmaxresult) {
      secmaxresult = result[i];
      secmaxresult_f = i;
    }
  }

  avg /= 8;
  for (int i = 0; i < 8; i++) {
    result[i] = 0;
  }

  if (maxresult > (avg + 3500)) {
    avg = 0;
    if (maxresult_f > secmaxresult_f) {
      t_y[t_ycounter] = maxresult_f;
      t_x[t_xcounter] = secmaxresult_f;
    }
    else {
      t_y[t_ycounter] = secmaxresult_f;
      t_x[t_xcounter] = maxresult_f;
    }
    t_xcounter++;
    t_ycounter++;
    /*Serial.print(maxresult_f);
      Serial.print(",");
      Serial.println(secmaxresult_f);*/
  }

  else {
    for (int i = 0 ; i < MAXSAMPLETEST; i++) {
      t_x[i] = 0;
      t_y[i] = 0;
    }
    t_xcounter = 0;
    t_ycounter = 0;
  }

  if (t_xcounter == MAXSAMPLETEST && t_ycounter == MAXSAMPLETEST) {
    t_xcounter = 0;
    t_ycounter = 0;
    for (int i = 0 ; i < MAXSAMPLETEST ; i++) {
      if (t_x[i] == 0 && t_y[i] == 4) dec_result[0]++;
      else if (t_x[i] == 0 && t_y[i] == 5) dec_result[1]++;
      else if (t_x[i] == 0 && t_y[i] == 6) dec_result[2]++;
      else if (t_x[i] == 0 && t_y[i] == 7) dec_result[3]++;
      else if (t_x[i] == 1 && t_y[i] == 4) dec_result[4]++;
      else if (t_x[i] == 1 && t_y[i] == 5) dec_result[5]++;
      else if (t_x[i] == 1 && t_y[i] == 6) dec_result[6]++;
      else if (t_x[i] == 1 && t_y[i] == 7) dec_result[7]++;
      else if (t_x[i] == 2 && t_y[i] == 4) dec_result[8]++;
      else if (t_x[i] == 2 && t_y[i] == 5) dec_result[9]++;
      else if (t_x[i] == 2 && t_y[i] == 6) dec_result[10]++;
      else if (t_x[i] == 2 && t_y[i] == 7) dec_result[11]++;
      else if (t_x[i] == 3 && t_y[i] == 4) dec_result[12]++;
      else if (t_x[i] == 3 && t_y[i] == 5) dec_result[13]++;
      else if (t_x[i] == 3 && t_y[i] == 6) dec_result[14]++;
      else if (t_x[i] == 3 && t_y[i] == 7) dec_result[15]++;
    }


    for (int i = 0 ; i < 16; i++) {
      if (dec_result[i] > maxdec_result) {
        maxdec_result = dec_result[i];
        maxdec_result_f = i;
      }
      dec_result[i] = 0;
    }
    if (maxdec_result_f == 0) Serial.println("1");
    if (maxdec_result_f == 1) Serial.println("2");
    if (maxdec_result_f == 2) Serial.println("3");
    if (maxdec_result_f == 3) Serial.println("A");
    if (maxdec_result_f == 4) Serial.println("4");
    if (maxdec_result_f == 5) Serial.println("5");
    if (maxdec_result_f == 6) Serial.println("6");
    if (maxdec_result_f == 7) Serial.println("B");
    if (maxdec_result_f == 8) Serial.println("7");
    if (maxdec_result_f == 9) Serial.println("8");
    if (maxdec_result_f == 10) Serial.println("9");
    if (maxdec_result_f == 11) Serial.println("C");
    if (maxdec_result_f == 12) Serial.println("*");
    if (maxdec_result_f == 13) Serial.println("0");
    if (maxdec_result_f == 14) Serial.println("#");
    if (maxdec_result_f == 15) Serial.println("D");

    maxdec_result = 0;
    maxdec_result_f = 0;
  }


  maxresult = 0;
  maxresult_f = 0;
  secmaxresult = 0;
  secmaxresult_f = 0;


}
